/dts-v1/;
/plugin/;

/ {
    compatible = "rockchip,rk3288-tinker", "rockchip,rk3288";

    fragment@0 {
        target = <&spi0>;
        __overlay__ {
            status = "okay";
            spidev@0 {
                status = "disabled"; // Disable generic spidev on CS0
            };
        };
    };

    fragment@1 {
        target = <&spi0>;
        __overlay__ {
            #address-cells = <1>;
            #size-cells = <0>;

            st7735r@0 {
                compatible = "sitronix,st7735r";
                reg = <0>; // Chip select 0
                spi-max-frequency = <16000000>; // 16 MHz, adjust if needed
                rotate = <90>; // Adjust rotation as needed (0, 90, 180, 270)
                fps = <60>;
                buswidth = <8>;
                dc-gpios = <&gpio3 18 1>;   // Pin 18 (GPIO3_C2), Active Low (1)
                reset-gpios = <&gpio3 23 1>; // Pin 22 (GPIO3_C7), Active Low (1)
                // No debug-gpios unless you specifically need/want it
                // No led-gpios as it's hardwired to 3.3V
                // For ST7735R, often the 'red', 'green', 'blue' init strings are used.
                // These are common for 128x160 ST7735R displays.
                // You might need to adjust if your display is different (e.g. 128x128)
                init = <0x01 0x80 0x00   // SWRESET + 128ms delay
                        0x11 0x80 0x00   // SLPOUT + 128ms delay
                        0xB1 0x00 0x053C3C // FRMCTR1
                        0xB2 0x00 0x053C3C // FRMCTR2
                        0xB3 0x00 0x053C3C 0x053C3C // FRMCTR3
                        0xB4 0x00 0x07     // INVCTR
                        0xC0 0x00 0xA25800 // PWCTR1
                        0xC1 0x00 0xC5     // PWCTR2
                        0xC2 0x00 0x0D00   // PWCTR3
                        0xC3 0x00 0x8D2A   // PWCTR4
                        0xC4 0x00 0x8DEE   // PWCTR5
                        0xC5 0x00 0x0E     // VMCTR1
                        0xE0 0x00 0x000E1A0B0410070207020F // GAMCTRP1
                        0xE1 0x00 0x001B190C0511080207020F // GAMCTRN1
                        0x3A 0x00 0x05     // COLMOD: 16-bit/pixel
                        0x36 0x00 0xC8     // MADCTL: MX, MY, RGB order (adjust if colors or orientation are wrong)
                        0x29 0x80 0x00>;  // DISPON + 128ms delay
                // bgr; // Add this if colors are swapped (blue/red). Remove if not.
            };
        };
    };
};